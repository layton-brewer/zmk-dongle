## boards/shields/lily58_dongle/Kconfig.defconfig
```kconfig
if SHIELD_LILY58_DONGLE

# Max 16 characters in keyboard name
config ZMK_KEYBOARD_NAME
    default "Lily58 Dongle"

config ZMK_SPLIT_ROLE_CENTRAL
    default y

config ZMK_SPLIT
    default y

# Lily58 has a left and a right half, so the dongle has 2 peripherals.
config ZMK_SPLIT_BLE_CENTRAL_PERIPHERALS
    default 2

# Set this to ZMK_SPLIT_BLE_CENTRAL_PERIPHERALS + your desired number of BT profiles (default is 5)
config BT_MAX_CONN
    default 7

# Set this to the same number as BT_MAX_CONN
config BT_MAX_PAIRED
    default 7

endif
```

## boards/shields/lily58_dongle/Kconfig.shield
```kconfig
# No whitespace after the comma or in the shield name!
config SHIELD_LILY58_DONGLE
    def_bool $(shields_list_contains,lily58_dongle)
```
